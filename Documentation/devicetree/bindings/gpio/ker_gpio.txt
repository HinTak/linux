## arch/arm/Kconfig.SABSP
```kconfig
menu "Samsung SP/BSP options"
comment "VDLinux 4.x SA/BSP patch"

config MINIMAL_CORE
		bool "Enable Small core dumps"
		default n
		depends on (COREDUMP=y && BINFMT_ELF=y)
		help
          coredump only current task for tracing crashes in Market with security (security TBD)
          Will dump only thread info, register context,
          File info, stack of crashed thread, .data and .bss section loaded memory
          and the areas in heap pointed by registers from r0-r12

config MINIMAL_CORE_COMP
		bool "Enable compression of Minimal core"
		depends on (MINIMAL_CORE=y && CRYPTO_DEFLATE=y)
		help
          Compress the minimal corefile Generated

config MINIMAL_CORE_ENCRYPT
		bool "Enable encryption of Minimal core"
		depends on (MINIMAL_CORE_COMP=y)
		help
          Encrypt the minimal corefile Generated

config USBEN_GPIO
	bool "gpio control support for usb power handling"
	default y
	help
	 It support gpio control for usb power 

config BLOCK_STOP_TTY
       bool "block stop_tty (Ctrl + S)"
       default y
       help
        Noise from UART can make stop signal. This option blocks stop_tty.

config MOUNT_SECURITY
       bool "security on mount command"
       default y
       help
        In case of release kernel build mode, This option will disable BIND option and apply NOEXEC option to all devices on mount command

config PROHIBIT_SIGNAL_HOOKING
		bool "coredump when user try signal_hooking"
		default n
		help
		In case of user app trying signal hooking, This option can stop user app and create coredump.

config PROHIBIT_USLEEP_0
		bool "coredump when user try usleep(0)"
		default n
		help
		In case of user app using usleep(0), This option can stop user app and create coredump.

config PREVENT_MIN_FREE_BYTES
		bool "prevent min_free_kbytes setting"
		default y
		help
			prevent min_free_kbytes setting from user (sysctl)

config MODULE_VER_CHECK_SKIP
		bool "Module version check skip"
		default n
		depends on MODVERSIONS=n
		help
		  'PRINT_MODULE_ADDR' option change VERMAGIC_STRING value. (e.g. 1003_192 DEBUG)
		  so, If you are using different version name, insmod will be failed
		  even while 'MODVERSION' option is off.
		  This option skip the checking the VERMAGIC_STRING.

config SQUASHFS_DEBUGGER
		bool "squashfs debugger v2.1"
		default y
		help
		  Tool for debugging squashfs error.
		  It is useful even to debug Flash I/O and memory un-safe problem.

config SQUASHFS_DEBUGGER_AUTO_DIAGNOSE
		bool "squashfs debugger auto diagnose"
		default y
		depends on SQUASHFS_DEBUGGER
		help
		  Diagnose the cause of squashfs error.

config MMC_BOOTING_SYNC
		bool "Wait rootfs mount try till mmc scan is done"
		default y
		help
		  If you use mmc device as rootfs, It could prevent mount fail issue.

config BUSYLOOP_WHILE_OOPS
		bool "busyloop while oops"
		default y
		help
			In case of oops, This option is useful for attach JTAG device.

config MMC_TIMEOUT
		bool "MMC_TIMEOUT"
		default n
		help
		  This config stops current mmc request.

config CA9_SYSTEM_HANG
		bool "CA9 SYSTEM HANG"
		default n
		help
		  This config decides whether it uses flush BTAC/BTB( Branch Target Buffer ) when context switch

config KPI_SYSTEM_SUPPORT
		bool "KPI (BP error check) system support"
		default n
		depends on SHOW_FAULT_TRACE_INFO
		help
	      It write error information(Tick, thread name, PC) when user fault is occured

config SWU_SUPPORT
		bool "SWU mode support for updating single exeDSP"
		default n
		help
		  For single exeDSP case, new update method/execution sequence are needed

config WRITE_PROTECT 
		bool "Flash write protection"
		default n
		help
		    Flash write protection

config MMC_POWER_ON_WRITE_PROTECTION
		bool "Use power on write protection"
		default n
		help
		  This will attemp to power on write protection for eMMC boot partition when eMMC init.

endmenu # end of "Samsung SA/BSP options" menu
```

## arch/arm/Kconfig.Secure
```kconfig
menu "CI+ Option"

config PROHIBIT_DEVMEM
		bool "prohibit access to /dev/mem and /dev/kmem"
		default n 
		help
		  It will prevent to access to /dev/mem and /dev/kmem for security issue.

config PROHIBIT_GROUP_SETUID
		bool "prohibit setuid operation for preventing privilege rise"
		default n 
		help
		  It will prevent to setuid implementation for security issue.

config EXECUTE_AUTHULD
	default n
	bool "Execute authuld program on background" 
	help
		decide whether executing authuld

choice
	prompt "1024 or 2048 RSA"
	default RSA2048
	depends on EXECUTE_AUTHULD=y
	
config RSA2048
	bool "RSA2048 setting"

config RSA1024
	bool "RSA1024 setting"
endchoice

config SHUTDOWN
	bool "Send shutdown signal to micom"
	default n
	depends on EXECUTE_AUTHULD=y 
	help
		decide whether send "shutdown" to micom or not

config MICOM_TTY_PATH
	string "tty device name(full path) for micom communication (ex: /dev/ttyS1)"
	default "/dev/ttyS1"
	depends on EXECUTE_AUTHULD=y 
	help
		device path setting for micom communication

config AUTHULD_PATH
	string "Path to authuld file"
	default "/bin/authuld" 
	depends on EXECUTE_AUTHULD=y 
	help
		Allows to redirect authuld files into specified location.

config TIMEOUT_ACK_AUTHULD
	int "Timout of authuld ack(minute)"
	default 3
	depends on EXECUTE_AUTHULD=y
	help
		if kernel do not get ACK from authuld, System will be down.

config USE_ARS
    bool "Anit RemoteShell Dummy function"
    default n

config PNACL
    bool "Modification for PNaCl"
    default n

endmenu # end of "CI+ Option" menu
```

## arch/arm/arm-boards/Kconfig
```kconfig
menu "Mstar platform type"
	depends on ARCH_MSTAR

config ARCH_MSTAR_CA9X4
	bool "Mstar Cortex-A9x4 tile"
	select CPU_V7
	select ARM_GIC
	select MIGHT_HAVE_CACHE_L2X0
endmenu


config MP_MSTAR_STR_BASE
	depends on ARCH_MSTAR && PM
	bool "Mstar Suspend To RAM Base"
```

## arch/arm/mach-mediatek/Kconfig
```kconfig
menu "Mediatek MT65xx & MT81xx SoC"

if ARCH_MEDIATEK

config MTK_HW_CLOCK
	bool
	default n

config MACH_MT8167
        bool "MediaTek MT8167"
        select GENERIC_TIME
        select GENERIC_CLOCKEVENTS
        select ARCH_HAS_CPUFREQ
        select ARM_AMBA
        select CPU_V7
        select HAVE_SMP
        select IRQ_DOMAIN
        select IRQ_DOMAIN_DEBUG
        select GENERIC_SCHED_CLOCK
        select MTK_SYS_CIRQ
        select ARMV7_COMPAT
        select ARMV7_COMPAT_CPUINFO
        select CPU_IDLE
        select PINCTRL
        select PINCTRL_MT8167
        select MFD_SYSCON
        select MTK_BASE_POWER
        select MTK_GIC_EXT
        select SMP
        select POWER_SUPPLY
        select POWER_RESET
        select HAVE_ARM_ARCH_TIMER
        select ARM_PSCI
        select HAVE_MTK_IN_HOUSE_TEE_SUPPORT
        select MTK_ICE_DEBUG
        select VFP
        select AEABI
        select NEON
        select KERNEL_MODE_NEON
        select HAVE_FUTEX_CMPXCHG
        select HIGHMEM
        select SPARSE_IRQ
        select MTK_HW_CLOCK
        help
          This enables support for MediaTek MT8167
          Support for arm Architecture
          
endif

endmenu
```

## arch/arm/mach-nvt72668/Kconfig
```kconfig
config ARCH_NVT72668
	bool "Novatek NVT72668 SoC (Cotex A9x4)" if ARCH_NVT_V7
	select ARM_GIC
	select CLKDEV_LOOKUP
	select COMMON_CLK
	select CPU_V7
	select GENERIC_CLOCKEVENTS
	select HAVE_CLK
	select HAVE_SMP
	select ARCH_REQUIRE_GPIOLIB
	select GPIO_SYSFS
	select MIGHT_HAVE_CACHE_L2X0
	select PLAT_NOVATEK_CLOCK
	select PLAT_NOVATEK
	help
	  This option enables support for systems using Cortex processor based
	  Novatek Cortex A9X4 72668 motherboard,
	  for example:

	  - Cortex-A9x4

	  You must boot using a Flattened Device Tree in order to use these
	  platforms. The traditional (ATAGs) boot method is not usable on
	  these boards with this option.

config ARCH_NVT72658
	bool "Novatek NVT72658 SoC"
	depends on ARCH_NVT72668
	help
	  This flag co-exist with ARCH_NVT72668 when build NVT72658 code base.
	  Source code should distinguish 72668 and 76258 by this flag.

config NVT_MMC_IF
	bool "NVT MMC host controller"
	depends on ARCH_NVT72668
	help
	  This will enable novatek mmc host controller.

config NVT_HW_CLOCK
	bool "NVT  HW clock driver"
	depends on ARCH_NVT72668
	help
	  Use CPU Global timer(64bit) to calculate time.
	  [(PRESCALER_value+1)x(Load_value+1)] / PERIPH_CLOCK

config NVT_HW_CLOCK_TEST
	bool "Test NVT HW clock"
	depends on NVT_HW_CLOCK
	help
	  Creat a file node that can test hw clock function
	  EX : cat proc/g_timer
	  Result :
		1st Get Gtimer time!
		Gtimer :  time      = xxxxx
		2nd Get Gtimer time!
		Gtimer :  time      = xxxxx + 10 sec
		3rd Get Gtimer time!
		Gtimer :  time      = xxxxx + 20 sec

choice
	prompt "NVT Machine model"
	depends on ARCH_NVT72668
	default MACH_NT14U_MANUAL

config MACH_NT14U_MANUAL
	bool "Machine NT14U"
	help
	  This will enable novatek machine NT14U.

config MACH_NT14M_MANUAL
	bool "Machine NT14M"
	help
	  This will enable novatek machine NT14M.
endchoice

config MACH_NT14U
	def_bool y
	depends on  MACH_NT14U_MANUAL

config MACH_NT14M
	def_bool y
	depends on  MACH_NT14M_MANUAL

config NVT_UART0_NOTTY
	bool "Access UART0 without TTY"
	default y
	depends on ARCH_NVT72668 
	help
	  Access UART0 without TTY.

config NVT_UNZIP
	bool "NVT GZIP decompressor"
	default n
	select HW_DECOMPRESSOR

config NVT_HW_SHA256
	bool "NVT H/W SHA"
	default n
```

## arch/arm/mach-nvt72xxx/Kconfig
```kconfig
choice
	prompt "Novatek board selection"
	depends on ARCH_NVT_V7
	default ARCH_NVT72658

config ARCH_NVT72668
	bool "Novatek NVT72668 SoC (Cotex A9x4)"
	select USB_ARCH_HAS_EHCI if USB_SUPPORT
	help
	  This option enables support for systems using Cortex processor based
	  Novatek Cortex A9X4 72668 motherboard,
	  for example:

	  - Cortex-A9x4

	  You must boot using a Flattened Device Tree in order to use these
	  platforms. The traditional (ATAGs) boot method is not usable on
	  these boards with this option.

config ARCH_NVT72658
	bool "Novatek NVT72658 SoC (Cotex A9x2)"
	select USB_ARCH_HAS_EHCI if USB_SUPPORT
	select ARCH_HAS_CPUFREQ
	select PM_OPP
	help
	  This option enables support for systems using Cortex processor based
	  Novatek Cortex A9x2 72658 motherboard,

config ARCH_NVT72172
	bool "Novatek NVT72172 SoC (Cotex CA53 aarch32)"
	select USB_ARCH_HAS_EHCI if USB_SUPPORT
	help
	  This option enables support for systems using Cortex processor based
	  Novatek Cortex CA53 aarch32 linux motherboard,

config ARCH_NVT72673
	bool "Novatek NVT72673 SoC (Cotex CA53 aarch32)"
	select USB_ARCH_HAS_EHCI if USB_SUPPORT
	help
	  This option enables support for systems using Cortex processor based
	  Novatek Cortex CA53 aarch32 linux motherboard,

config ARCH_KANTL
	bool "Novatek KANTL SoC (Cotex A9x2)"
	select USB_ARCH_HAS_EHCI if USB_SUPPORT
	select ARCH_HAS_CPUFREQ
	select PM_OPP
	help
	  This option enables support for systems using Cortex processor based
	  Novatek Cortex A9x2 NT17M motherboard,
endchoice

config NVT_HW_CLOCK_ENABLE
	bool "Enable NVT HW clock driver"
	depends on ARCH_NVT_V7
	default n
	help
		This config enable the option to choose NVT_CA53_HW_CLOCK or NVT_HW_CLOCK

choice
	prompt "Novatek hw clock driver selection"
	depends on NVT_HW_CLOCK_ENABLE
	default NVT_CA53_HW_CLOCK

config NVT_CA53_HW_CLOCK
    bool "NVT CA53 HW clock driver"
    depends on PLAT_NOVATEK
    help
      NVT HW clock driver
      Use CA53 CPU physical timer(64bit) to calculate time.

config NVT_HW_CLOCK
    bool "NVT HW clock driver"
    depends on PLAT_NOVATEK
    help
      NVT HW clock driver
      Use CPU Global timer(64bit) to calculate time.
      formula :
      [(PRESCALER_value+1)x(Load_value+1)] / PERIPH_CLOCK

endchoice

config NVT_HW_CLOCK_TEST
    bool "Test NVT HW clock"
    depends on NVT_HW_CLOCK || NVT_CA53_HW_CLOCK
    help
      Creat a file node that can test hw clock function
      EX : cat proc/g_timer
      Result :
        1st Get Gtimer time!
        Gtimer :  time      = xxxxx
        2nd Get Gtimer time!
        Gtimer :  time      = xxxxx + 10 sec
        3rd Get Gtimer time!
        Gtimer :  time      = xxxxx + 20 sec

config ARCH_PRENT17M
	bool "Novatek PreNT17M Config"
	help
	  This option enables support for PreNT17M platform
```

## arch/arm/mach-sdp/Kconfig
```kconfig
######################################################################
#
# 	Kconfig for machine about Costom Consumer Electronics 
# 	
# 	created by tukho.kim@samsung.com
#
######################################################################
#
# 5 Feb 2013	support linux-3.8.x for golf-s
# May,31,2010	created by tukho.kim
# 

if ARCH_SDP

# machine types
choice
	prompt "SDP Machine type"
	default MACH_FOXAP

config MACH_SDP_DT
	bool "Samsung DTV Machine using device tree"
	select USE_OF
	select ARM_GIC
	select GIC_NON_BANKED
	select USB_ARCH_HAS_EHCI if USB_SUPPORT
	select USB_ARCH_HAS_OHCI if USB_SUPPORT
	select USB_ARCH_HAS_XHCI if USB_SUPPORT
	select PINCTRL
	select PINCTRL_SDP
	select ARCH_REQUIRE_GPIOLIB
	select ARCH_DMA_ADDR_T_64BIT if ARM_LPAE
	select ARM_HAS_SG_CHAIN
 	help
	  Say 'Y' here if you want your kernel to support the
	  Samsung DTV using flattened device tree.

config MACH_FOXAP
	bool "Fox-AP platform, 2012"
	select ARCH_SDP1202
	select ARM_PATCH_PHYS_VIRT
	select ARCH_HAS_HOLES_MEMORYMODEL
	help
	  This enables support for Fox-P Samsung VD BD board.

config MACH_FOXB
	bool "Fox-B platform, 2012"
	select ARCH_SDP1207
	select ARM_PATCH_PHYS_VIRT
	select ARCH_HAS_HOLES_MEMORYMODEL
	help
	  This enables support for Fox-B Samsung VD BD board.

config MACH_ECHOP
	bool "Echo-P platform, 2011"
	select ARCH_SDP1106
	select ARM_PATCH_PHYS_VIRT
	select ARCH_HAS_HOLES_MEMORYMODEL
	help
	  This enables support for Echo-P Samsung VD DTV board.

endchoice

if MACH_FOXB
source "arch/arm/mach-sdp/platform/foxb/Kconfig"
endif

if MACH_ECHOP
source "arch/arm/mach-sdp/platform/echop/Kconfig"
endif

# SoC types
config ARCH_SDP1202
	bool
	select ARCH_SDP_SOC_CA15
	select HAVE_SMP
	select LOCAL_TIMERS if SMP
	select SDP12XX_TIMER
	select ARM_GIC
	select GIC_NON_BANKED
	select ARCH_HAS_CPUFREQ
	select CPU_FREQ

config ARCH_SDP1207
	bool
	select ARCH_SDP_SOC_CA9
	select HAVE_SMP
	select LOCAL_TIMERS
	select SDP12XX_TIMER
	select ARM_GIC
	select ARM_ERRATA_754322
	select ARM_ERRATA_764369
	select SDP_MAC_NORMAL_DESC if SDP_MAC

config ARCH_SDP1106
	bool
	select ARCH_SDP_SOC_CA9
	select HAVE_SMP
	select LOCAL_TIMERS if SMP
	select SDP12XX_TIMER
	select ARM_GIC

config ARCH_SDP1202_EVAL
        bool "SDP1202 Eval board"
        depends on ARCH_SDP1202

config ARM_TRUSTZONE
	bool "Support TrustZone-enabled Trusted Execution Environment"
	default n
	help
	  Select if you want a kernel to be executed at non-secure world.
	  This option should be used with related secure bootloader and
	  TrustZone software.

	  If you don't know about TrustZone, say 'N'.


# ARM Core type
config ARCH_SDP_SOC_CA9
	bool

config ARCH_SDP_SOC_CA15
	bool

config ARCH_SDP_PL310
	bool "Enables PL310 L2 cache controller"
	depends on ARCH_SDP_SOC_CA9
	default y
	select CACHE_L2X0
	select CACHE_PL310

menu "Select ARM Errata Patch"

endmenu

endif # ARCH_SDP	
```

## arch/arm/mach-sdp/platform/foxb/Kconfig
```kconfig
config SATA_FOXB
	tristate "Support SDP1207 Fox-B SATA Hosts"
	select	ATA_SFF
	select	SATA_PMP
	help
	  For historical reason, fox-b is using custom ahci driver,
	  forked from older version of linux kernel.
```
