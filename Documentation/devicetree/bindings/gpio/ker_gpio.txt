## Documentation/devicetree/bindings/gpio/ker_gpio.txt
```
gpioa: gpio@fd0f0000 {
			compatible = "nvt,nt726xx-gpio";
			reg = <0xfd0f0000 0x18>,
			<0xfd0f0200 0x18>,
			<0xfd100000 0x18>,
			<0xfd110000 0x18>,
			<0xfd110200 0x18>;
			nvt,hwmods = "gpioa";
			nvt,gpio-always-on;
			gpio-controller;
			#gpio-cells = <2>;};
```

## Documentation/devicetree/bindings/i2c/ker_i2c.txt
```
i2c0: i2c@fd000000 {
	compatible = "nvt,nt726xx_i2c.0";
	nvt,hwmods = "i2c0";
	reg = <0xfd000000 0x100>;
	interrupts = <0x0 0x43 0x4>;
	clock-frequency = <400>;
	#address-cells = <1>;
	#size-cells = <0>;
	};
i2c1: i2c@fd000100 {
	compatible = "nvt,nt726xx_i2c.1";
	nvt,hwmods = "i2c1";
	reg = <0xfd000100 0x100>;
	interrupts = <0x0 0x43 0x4>;
	clock-frequency = <400>;
	#address-cells = <1>;
	#size-cells = <0>;
	};
i2c2: i2c@fd000200 {
	compatible = "nvt,nt726xx_i2c.2";
	nvt,hwmods = "i2c2";
	reg = <0xfd000200 0x100>;
	interrupts = <0x0 0x43 0x4>;
	clock-frequency = <400>;
	#address-cells = <1>;
	size-cells = <0>;
	};
i2c3: i2c@fd000300 {
	compatible = "nvt,nt726xx_i2c.3";
	nvt,hwmods = "i2c3";
	reg = <0xfd000300 0x100>;
	interrupts = <0x0 0x43 0x4>;
	clock-frequency = <400>;
	#address-cells = <1>;
	#size-cells = <0>;
	};
i2c4: i2c@fd000400 {
	compatible = "nvt,nt726xx_i2c.4";
	nvt,hwmods = "i2c4";
	reg = <0xfd000400 0x100>;
	interrupts = <0x0 0x43 0x4>;
	clock-frequency = <400>;
	#address-cells = <1>;
	#size-cells = <0>;
	};
i2c5: i2c@fd000500 {
	compatible = "nvt,nt726xx_i2c.5";
	nvt,hwmods = "i2c5";
	reg = <0xfd000500 0x100>;
	interrupts = <0x0 0x43 0x4>;
	clock-frequency = <400>;
	#address-cells = <1>;
	#size-cells = <0>;
	};
```

## Documentation/devicetree/bindings/media/nvt_irb.txt
```
Device-Tree bindings for SUNXI IR controller found in sunXi SoC family

Required properties:
- compatible	    : "nvt,nvt-irb"
- interrupts	    : should contain IRB IRQ number;
- reg		    : should contain IO map address for IRB.

Optional properties:

Example:

nvt_irb: nvt_irb@fd0a8000 {
    compatible = "nvt,nvt-irb";
    reg = <0xfd0a8000 0x200>;
    interrupts = <0x0 0xb1 0x4>;
};
```

## Documentation/devicetree/bindings/media/nvt_irs.txt
```
Device-Tree bindings for SUNXI IR controller found in sunXi SoC family

Required properties:
- compatible	    : "nvt,nvt-irs"
- interrupts	    : should contain IRS IRQ number;
- reg		    : should contain IO map address for IRS.

Optional properties:

Example:

nvt_irs: nvt_irs@fd0ac000 {
    compatible = "nvt,nvt-irs";
    reg = <0xfd0ac000 0x200>;
    interrupts = <0x0 0xb2 0x4>;
};
```

## Documentation/devicetree/bindings/misc/nvt-atf.txt
```
Novatek atf engine
-----------------------------------------------------
This binding defines the location of the bounce buffer
used for non-secure to secure communications.

Required properties:
- compatible : "nvt,atf"
- reg :	register space

Example:
	atf@0xfd060100 {
		compatible = "nvt,atf";
		interrupts = <0 57 4>;
		reg = <0xfd060100 0xc0>;
	};
```

## Documentation/devicetree/bindings/nvt/ca9.txt
```
Main node required properties:

- compatible : should be one of:
	"nvt,ca9,72668"
	"nvt,ca9,72658"
```

## Documentation/devicetree/bindings/nvt/periph_clk.txt
```
Main node required properties:

- compatible : should be one of:
	"nvt,periph_clk"
```
