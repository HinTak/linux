## security/sfd/Kconfig
```kconfig
#
# Security Filter Driver
#

menu "Security Filter Driver (Smart Security)"

config SECURITY_SFD
	bool "Security Filter Driver support"
	default n
	select SFLIB
	help
		This selects SFD, which filter system events. SFD working
		in two modes:
			1. Enforce
			2. Permissive

		TODO: To add more information later.

		If you unsure how to answer this question, answer N.

choice
	prompt "Working mode"
	depends on SECURITY_SFD
	help
		Select the Security Filter Driver working mode.

	config SECURITY_SFD_MODE_PERMISSIVE
		bool "Permissive mode"
		help
			Do not perform any blocking for the system routines.

	config SECURITY_SFD_MODE_ENFORCE
		bool "Enforce mode"
		help
			Blocks system routines that can not meet Security Filter Driver policy.

endchoice


choice
	prompt "Working level"
	depends on SECURITY_SFD
	help
		Select the working level for Security Filter Driver components.
		The following work levels are possible:
			1. Debug level
			2. Release mode

	config SECURITY_SFD_LEVEL_DEBUG
		bool "Debug level"
		help
			This selects debug working level for Security Filter Driver and
			all components.

	config SECURITY_SFD_LEVEL_RELEASE
		bool "Release level"
		help
			This selects release working level for Security Filter Driver and
			all components.

endchoice


config SECURITY_SFD_SECURECONTAINER
	bool "Secure Container support"
	depends on SECURITY_SFD
	default y
	help
		Sfd supports to prevent accessing to directory from processes which are not related to SecureContainer.


choice
	prompt "Secure Container Mode"
	depends on SECURITY_SFD_SECURECONTAINER
	help
		Select the Secure Container working mode.

	config SECURITY_SFD_SECURECONTAINER_MODE_PERMISSIVE
		bool "Permissive mode"
		help
			Do not perform any blocking for Secure Container

	config SECURITY_SFD_SECURECONTAINER_MODE_ENFORCE
		bool "Enforce mode"
		help
			Blocks any access to path of Secure Container
endchoice


config SECURITY_SFD_RWDEV_PREFIXES
	string "RW device name prefix for SFD"
	default "/dev/partition:tmpfs:loop"
	depends on SECURITY_SFD
    help
        SFD filters the behavior of file/network/process which occurs on only RW directory. To figure out the original path of file, this device prefix should be set.

config SECURITY_SFD_CHECK_STATFS
	bool "Check mount flag"
	depends on SECURITY_SFD
	default y
	help
		Sfd checks mount point(RO/RW) or directory(/opt,/tmp/...)

source security/sfd/dispatcher/Kconfig
source security/sfd/notifier/Kconfig
source security/sfd/uep/Kconfig

endmenu
```

## security/sim/Kconfig
```kconfig
#
# SIM (System Integrity Monitor) built-in module
#

config SECURITY_SIM
	bool "SIM built-in module"
	default y
	help
		SIM built-in module support SIM(System Integrity Monitor). 
		SIM checks integrity of kernel, file.

config SECURITY_SIM_DEBUG
	bool "print for debugging"
	depends on SECURITY_SIM && !VD_RELEASE
	default y
	help
		If it is y, Print both debug and error logs.
		If it is n, Print error logs only.


#
# SIM Watchdog
#

config SECURITY_SIM_WATCHDOG
	bool "SIM Watchdog"
	depends on SECURITY_SIM && SECURITY_SFD && SECURITY_SFD_DISPATCHER_LOAD_KERNEL_MODULE
	default y
	help
		SIM Watchdog checks integrity of important files of SIM.
		SIM Watchdog use sfd verification function to check integrity.
```

## security/smack/Kconfig
```kconfig
config SECURITY_SMACK
	bool "Simplified Mandatory Access Control Kernel Support"
	depends on NET
	depends on INET
	depends on SECURITY
	select NETLABEL
	select SECURITY_NETWORK
	default n
	help
	  This selects the Simplified Mandatory Access Control Kernel.
	  Smack is useful for sensitivity, integrity, and a variety
	  of other mandatory security schemes.
	  If you are unsure how to answer this question, answer N.

config SECURITY_SMACK_BRINGUP
	bool "Reporting on access granted by Smack rules"
	depends on SECURITY_SMACK
	default n
	help
	  Enable the bring-up ("b") access mode in Smack rules.
	  When access is granted by a rule with the "b" mode a
	  message about the access requested is generated. The
	  intention is that a process can be granted a wide set
	  of access initially with the bringup mode set on the
	  rules. The developer can use the information to
	  identify which rules are necessary and what accesses
	  may be inappropriate. The developer can reduce the
	  access rule set once the behavior is well understood.
	  This is a superior mechanism to the oft abused
	  "permissive" mode of other systems.
	  If you are unsure how to answer this question, answer N.

config SECURITY_SMACK_NETFILTER
	bool "Packet marking using secmarks for netfilter"
	depends on SECURITY_SMACK
	depends on NETWORK_SECMARK
	depends on NETFILTER
	default n
	help
	  This enables security marking of network packets using
	  Smack labels.
	  If you are unsure how to answer this question, answer N.

config SECURITY_SMACK_LOG_FOR_REL
	bool "SMACK remove the limitation of audit log for release version"
	depends on SECURITY_SMACK
	depends on AUDIT
	default n
	help
	  Using this option we can remove limitation of smack error log.
	  If we use this option smack log will not be lost . This option categorise
	  printk log level as given below.
	  log count less than 10 : KERN_ERR
	  log count more than 10 : KERN_INFO

config SECURITY_SMACK_BOOTMODE_FOR_DEV_NODE
	bool "SMACK feature to control device node label setting and access timing at system boot"
	depends on SECURITY_SMACK
	default n
	help
	  If there is permission error at device node file access time,
	  at present system crashes.In current scenario, there is possibility
	  for delay in device label setting due to performance.
	  Using this option, if there is permission error while accessing
	  device node file at boot time,process will wait 5sec for smack label
	  to get set. If smack label gets set within 5sec then process will
	  wakeup and try again make permission check for device file access.

config SECURITY_SMACK_SYSTEM_MODE
	bool "SMACK system mode setting"
	depends on SECURITY_SMACK
	default n
	help
	Using this option we can select system wide mode for SMACK module.
	If it is set to y in that case there will be SMACK permissive mode
	and rule list check for different system calls but no permission error.
	By default this is set to y.

config SECURITY_SMACK_SET_DEV_SMK_LABEL
	bool "SMACK support to set label of device driver file(devtmpfs)"
	depends on SECURITY_SMACK
	depends on DEVTMPFS
	default y
	help
	Using this option we can setting the smack label with same timming whitch
	the device driver create. If we use this CONFIG, It will be remove timming
	issue between create time of drvier and set time of smack label.
	And If we use this CONFIG, we can remove all of job to set smack label and
	wait untill set untill smack label by user area.

config SECURITY_SMACK_KUBT_OF_SMACK_ERR
       bool "SMACK feature to give user backtrace for smack error"
       depends on SECURITY_SMACK
       depends on KDEBUGD
       default n
       ---help---
       If there is permission error at file access time,
       It is difficult to find in which module error occurred using
       smack log. Because some processes link to many kind of libraries.
       and if it is very complex code logic then it is very difficult to
       find correct error cause.If there is user backtrace information,
       then it is easy to define the place and reason of smack error.
```

## sound/soc/codecs/dbmdx/Kconfig
```kconfig
#
# DBMDX SoC audio configuration
#
#

# DBMDX SOC enabler.
# y - Enable DSPG VT/VE Chip
# n - Disable DSPG VT/VE Chip
# m - Build as module
config SND_SOC_DBMDX
	tristate "DSPG Voice Trigger/Enhancement Chip"
	default n
	help
		DSPG Voice Trigger/Enhancement Chip
		y - Enable DSPG VT/VE Chip
		n - Disable DSPG VT/VE Chip
		m - Build as module

# Register DBMDX SOC as a separate sound card.
# y - Register DBMDX SOC as separate sound card
# n - Do not register DBMDX SOC as separate sound card
# .
config SND_SOC_DBMDX_SND_CAPTURE
	bool "DSPG Capture Device Support"
	depends on SND_SOC_DBMDX
	default n
	help
		Register DBMDX SOC as a separate sound card.
		.
		y - Register DBMDX SOC as separate sound card
		n - Do not register DBMDX SOC as separate sound card

# Noise Suppression Algorithm Support (Only DBMD8 chip)
# .
# y - Enable Noise Suppression Algorithm Support
# n - Do not enable Noise Suppression Algorithm Support
config SND_SOC_DBMDX_VA_NS_SUPPORT
	bool "Noise Suppression Algorithm Support (Only DBMD8 chip)"
	depends on SND_SOC_DBMDX
	default n
	help
		Noise Suppression Algorithm Support (Only DBMD8 chip).
		.
		y - Enable Noise Suppression Algorithm Support
		n - Do not enable Noise Suppression Algorithm Support

# Support Private IOCTL interface
# .
# y - Enable IOCTL command interface
# n - Do not enable IOCTL command interface
config SND_SOC_DBMDX_IOCTL_SUPPORT
	bool "IOCTL Command interface"
	depends on SND_SOC_DBMDX
	default n
	help
		IOCTL Command Interace support.
		.
		y - Enable IOCTL command interface
		n - Do not enable IOCTL command interface


# Register DBMDX SOC as a separate sound card.
# .
# .
# .
config SND_SOC_DBMD4_SPI
	bool "DSPG Voice Trigger/Enhancement Chip - DBMD4 SPI"
	default n
	help
		DSPG Voice Trigger/Enhancement Chip SPI Interface
		.
		.
		.

# Register DBMDX SOC as a separate sound card.
# .
# .
# .
config SND_SOC_DBMD4_I2C
	bool "DSPG Voice Trigger/Enhancement Chip - DBMD4 I2C"
	default n
	help
		DSPG Voice Trigger/Enhancement Chip SPI Interface
		.
		.
		.

# Register DBMDX SOC as a separate sound card.
# .
# .
# .
config SND_SOC_DBMD4_UART
	bool "DSPG Voice Trigger/Enhancement Chip - DBMD4 UART"
	default n
	help
		DSPG Voice Trigger/Enhancement Chip SPI Interface
		.
		.
		.

# Register DBMDX SOC as a separate sound card.
# .
# .
# .
config SND_SOC_DBMD2_SPI
	bool "DSPG Voice Trigger/Enhancement Chip - DBMD2 SPI"
	default n
	help
		DSPG Voice Trigger/Enhancement Chip SPI Interface
		.
		.
		.

# Register DBMDX SOC as a separate sound card.
# .
# .
# .
config SND_SOC_DBMD2_I2C
	bool "DSPG Voice Trigger/Enhancement Chip - DBMD2 I2C"
	default n
	help
		DSPG Voice Trigger/Enhancement Chip SPI Interface
		.
		.
		.

# Register DBMDX SOC as a separate sound card.
# .
# .
# .
config SND_SOC_DBMD2_UART
	bool "DSPG Voice Trigger/Enhancement Chip - DBMD2 UART"
	default n
	help
		DSPG Voice Trigger/Enhancement Chip SPI Interface
		.
		.
		.
```
