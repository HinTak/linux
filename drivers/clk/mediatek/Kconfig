## drivers/samsung/smart_deadlock/Kconfig
```kconfig
menu "Smart Deadlock Detector Support"

config SMART_DEADLOCK
	bool "Smart Deadlock Detecting Framwork"
	default n
	help
	This frame-work is for detecting watchdog system of TizenTV(systemd/ANR)
	If there is deadlock problem in TizenTV, it is very difficult to define
	the reason. So this feature will just report whenever deadlock occurs in
	any service.This feature is for only TizenTV system.

config SMART_DEADLOCK_PROFILE_MODE
	bool "Smart Deadlock Profile Mode"
	default n
	depends on SMART_DEADLOCK
	depends on KDEBUGD
	help
	This option will enable profiling in smart deadlock framework. It means that
	now deadlock detector framework will also collect backtrace information of the
	processes. Now whenever deadlock occurs in any service, then deadlock detector
	framework will also store the backtrace information of the deadlock process in
	a file using dlog.

config SMART_DEADLOCK_ALL_THREAD_BACKTRACE
        bool "Smart Deadlock All Thread Backtrace"
        default n
        depends on SMART_DEADLOCK_PROFILE_MODE
        help
        This option will enable printing of all thread backtrace when deadlock is
	declared on a process waiting in pthread_cond_wait.

config SMART_DEADLOCK_DELAY_LAUNCH_LLDB
	bool "Smart Deadlock Delay Launch LLDB"
	default n
	depends on SMART_DEADLOCK_PROFILE_MODE
	help
	This option will enable delayed launching of vd-lldb directly from smart-deadlock-module.

config SMART_DEADLOCK_TIMEOUT_DELAY
	bool "Smart Deadlock Timeout Delay"
        default n
        depends on SMART_DEADLOCK_PROFILE_MODE
        help
        This option will extend the watchdog timeout of processes in entry models.

endmenu
```

## drivers/soc/imx/Kconfig
```kconfig
#
# IMX Soc drivers
#
menu "NXP IMX SoC drivers"

config HAVE_IMX_MU
	bool

config HAVE_IMX_RPMSG
	select RPMSG_VIRTIO
	select RPMSG
	bool
endmenu
```

## drivers/soc/novatek/Kconfig
```kconfig
#
# Novatek SOC drivers
#
config SOC_NVT
	bool "Novatek SoC(NVT) drivers support"
	default y if ARCH_NVT
        help
       	  Say y here to enable NVT SOC support.  These provides driver
          functions for hwgzip, sda, and another. Please enable SOC_NVT
	  when you want to use them.

if SOC_NVT

config NVT_UNZIP
	bool "NVT UNZIP decompressor driver"
	default y
	help
          Say y here to enable NVT UNZIP support.
	  These provides driver functions for hwgzip.
	  currently zlib/gzip is supported.
	  the driver support hw1/hw2 for vdfs.
	  please check related configure file when using it.

#config NVT_UNZIP_HWDCOMP_VDFS
#	bool "Use H/W decompresser for VDFS"
#	depends on NVT_UNZIP
#	select HW_DECOMPRESSOR

config NVT_UNZIP_AUTH
	bool "Use H/W Auth(AES-CTR, SHA256)"
	depends on NVT_UNZIP
	default n


config NVT_UNZIP_FIFO
	bool "NVT UNZIP decompressor ATF driver"
	default n
	depends on NVT_UNZIP
	help
          Say y here to enable NVT UNZIP FIFO support.
	  These provides driver functions for hwgzip.
	  currently zlib/gzip is supported.
	  the driver support hw1/hw2 for vdfs.
	  please check related configure file when using it.

endif#SOC_NVT
```

## drivers/soc/sdp/Kconfig
```kconfig
#
# Samsung VD SOC drivers
#
config SOC_SDP
	bool "Samsung VD SoC(SDP) drivers support"
	default y if ARCH_SDP

if SOC_SDP

##************** SDP UNZIP ****************##
config SDP_UNZIP
	bool "SDP UNZIP decompressor driver"
	default y

config SDP_UNZIP_HWDCOMP_VDFS
	bool "Use H/W decompresser for VDFS"
	depends on SDP_UNZIP
	select HW_DECOMPRESSOR

config SDP_UNZIP_AUTH
	bool "Use H/W Auth(AES-CTR, SHA256)"
	depends on SDP_UNZIP && (ARCH_SDP1501||ARCH_SDP1601)
	select SDP_UNZIP_AUTH_STANDALONE if (ARCH_SDP1601)
	default y

config SDP_UNZIP_AUTH_STANDALONE
	depends on SDP_UNZIP
	bool

config SDP_UNZIP_SELFTEST
	bool "Use SDP UNZIP Driver Selftest sysfs"
	depends on SDP_UNZIP
	select CRYPTO
	select CRYPTO_CTR
	select CRYPTO_SHA256
	select CRYPTO_DEFLATE
	select CRYPTO_ZLIB
	default n

config SDP_UNZIP_TEST
	bool "SDP UNZIP Test Module"
	depends on SDP_UNZIP
	default n




config SDP_SPI
		tristate "SDP SPI Master Controller Driver"
		default n
		depends on ARCH_SDP
		select SPI
		select SPI_MASTER
		help
		  SDP SPI Master Controller Driver.

config SDP_SPI_NUM_OF_CS
		int "Number of chip select."
		default 1
		depends on SDP_SPI
		help
		  Default CS is 1, but if you used the GPIO CS, CS can be larger than 1.

config SDP_SPIDEV
		tristate "User Level SPI Device Driver for SDP SPI"
		depends on SDP_SPI

config SDP_SPI_DEBUG
		bool "Print Debug Msg for SDP SPI"
		depends on SDP_SPI


config SDP_THERMAL
	depends on ARCH_SDP && CPU_FREQ
	bool "Thermal Management"
	default y

config SDP_BUS_ERR_LOGGER
	bool "SDP bus err logger"
	default y

config SDP_IOTMODE_HOT_SWITCH
	depends on POWER_SAVING_MODE
	bool "Support IOT power on/off in running state"
	default y
	help
		If enable this, tztv-media driver will enter power off state directly in iot mode.



config SDP_MICOM_CECIF
	bool "SDP Micom CECIF Driver for control by Main"
	depends on SDP_MICOM_CONTROLLER
	select MFD_SYSCON
	select CEC_CORE
	default n

config SDP_MICOM_CECIF_TEST
	tristate "SDP Micom CECIF Driver Test"
	depends on (SDP_MICOM_CECIF && !SDP_MICOM_CECIF_SUPPORT_SUBSYSTEM)
	default n

config SDP_MICOM_CECIF_SUPPORT_SUBSYSTEM
	bool "CECIF driver to support cec subsystem api"
	depends on (SDP_MICOM_CECIF && CEC_CORE)
	default n

config SDP_MICOM_PINCTRL
	bool "SDP Micom Pin control by Main"
	depends on PINCTRL
	default y

config SDP_DEV_PM
	depends on POWER_SAVING_MODE
    bool "SDP device power manage helper"
    default y

config SDP_RUNTIME_PM
    bool "SDP device runtime power manage helper"
    default y

config SDP_SMEM
	bool "Samsung SMEM allocator"
	depends on DMA_CMA && HAS_DMA && MMU
	select GENERIC_ALLOCATOR
	default y
	help
		Samsung SMEM memory allocator.

config SDP_SMEM_CACHE
	bool "Use Cache backend"
	depends on SDP_SMEM
	default n

config SDP_SMEM_TEST
	tristate "Samsung SMEM allocator test driver"
	depends on SDP_SMEM
	default m

config SDP_AVS
	bool "Adaptive Voltage Scaling for SDP SoC"
	default n

endif#SOC_SDP
```

## drivers/usb/usb_snapshot/Kconfig
```kconfig
#PRALLEL RESUME configauration

config SAMSUNG_USB_PARALLEL_RESUME
        tristate "Parallel Resume of Samsung Priority Device List"
        depends on USB && PM
        default n if USB && PM
        help
      if you say y here, it will Enable Fast and Parallel Resume
      of Samsung Priority Device List.
        
config SAMSUNG_USB_SERDES_LOCK_CHECK
    bool "Enable serdes lock check for KantM OC Model"
    depends on SAMSUNG_USB_PARALLEL_RESUME
    default n
    help
        KantM-(Built in, OCM or OC) => Y
        Kant AV => N
        Kant S => N
```

## fs/exfat/Kconfig
```kconfig
config EXFAT_FS
	tristate "exfat support"
	select NLS
	default m
	help
	  This enables the exfat filesystem support in Kernel.
	  To compile this as a module, choose M here.
```

## fs/udf/Kconfig
```kconfig
config UDF_FS
	tristate "UDF file system support"
	select CRC_ITU_T
	help
	  This is a file system used on some CD-ROMs and DVDs. Since the
	  file system is supported by multiple operating systems and is more
	  compatible with standard unix file systems, it is also suitable for
	  removable USB disks. Say Y if you intend to mount DVD discs or CDRW's
	  written in packet mode, or if you want to use UDF for removable USB
	  disks. Please read <file:Documentation/filesystems/udf.txt>.

	  To compile this file system support as a module, choose M here: the
	  module will be called udf.

	  If unsure, say N.

config UDF_NLS
	bool
	default y
	depends on (UDF_FS=m && NLS) || (UDF_FS=y && NLS=y)

config SSIF_EXT_CACHE
	bool "BD UDF Extents Cache (for 3D BD)"
	default n
	depends on UDF_FS=m || UDF_FS=y
	help
	 The 3D Blu-ray has many extents. So it make slow read problem when play it.
	 This problem also occur even we play 3D Blu-ray with 2D mode.
	 So remember last accessed inode to enhance read performance of 3D Blu-ray.
```

## ipc/kdbus/Kconfig
```kconfig
config KDBUS
       tristate "kdbus interprocess communication"
       depends on TMPFS
       help
         D-Bus is a system for low-latency, low-overhead, easy to use
         interprocess communication (IPC).

         See Documentation/kdbus.txt

         To compile this driver as a module, choose M here: the
         module will be called kdbus.

config KDBUS_DEBUG
       bool "kdbus debug infrastruture"
       depends on KDBUS
       help
         This enable kdbus debug feature which provides useful information
         for diagnosis.

config KDBUS_DEBUG_TRACE
       bool "kdbus connection based history tracer"
       depends on KDBUS_DEBUG
       help
         Connection based histroy tracer

config KDBUS_DEBUG_NUM_TRACES 
	   int "Number of footprints to be traced"
       default 30
       depends on KDBUS_DEBUG_TRACE
```
