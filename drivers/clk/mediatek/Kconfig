## drivers/clk/mediatek/Kconfig
```kconfig
#
# MediaTek Clock Drivers
#
menu "Clock driver for MediaTek SoC"
	depends on ARCH_MEDIATEK || COMPILE_TEST

config COMMON_CLK_MEDIATEK
	bool
	select RESET_CONTROLLER
	---help---
	  MediaTek SoCs' clock support.

config COMMON_CLK_MT8167
	bool "Clock driver for MediaTek MT8167"
	depends on ARCH_MEDIATEK || COMPILE_TEST
	select COMMON_CLK_MEDIATEK
	default ARCH_MEDIATEK
	---help---
	  This driver supports MediaTek MT8167 clocks.

endmenu
```

## drivers/cpe/Kconfig
```kconfig
#
# OTP configuration
#

config CPE_OTP
	tristate "NVT OTP Driver"
	default n
	help
	  Enable the OTP read.
```

## drivers/media/platform/sdp-dvb/Kconfig
```kconfig
config DVB_SDP
	tristate "SDP DVB base driver"
	depends on DVB_CORE
	depends on ARCH_SDP
	default n
	help
	  DVB base drivers for SDP.
```

## drivers/misc/mediatek/Kconfig
```kconfig
menuconfig MEDIATEK_SOLUTION
        bool "MediaTek Properitary Configuration"
        select I2C
        help
          Check this to enable MediaTek properity configuration.

if MEDIATEK_SOLUTION

config MTK_PLATFORM
        string "MTK platform name"

config ARCH_MTK_PROJECT
        string "MTK project name"

config MTK_KERNEL_SOLUTION
        bool "MediaTek Kernel Solution Configuration"
	default y

config MTK_TEMP_TIZEN_SOLUTION
        bool "MediaTek Kernel temporary Tizen solution Configuration."
        default y
        help
          To setup Tizen 3.0 environment. Some codes are modified by this configuration.
          It should be removed not so far.

menu "Storage: EMMC, NAND, partition..."
endmenu  # Storage

menu "Power, PMIC, Battery & Low Power related configs"
endmenu

menu "MultiMedia, Display, Camera related configs"
endmenu

menu "Sensors"
endmenu

menu "Modem & Connectivity related configs"
endmenu  # CONN

menu "Other Peripherals"
source "drivers/misc/mediatek/usb11/Kconfig"
source "drivers/misc/mediatek/usb20/Kconfig"
source "drivers/misc/mediatek/btif/Kconfig"
source "drivers/misc/mediatek/connectivity/Kconfig"
source "drivers/misc/mediatek/ice_debug/Kconfig"
source "drivers/misc/mediatek/xo/Kconfig"
source "drivers/misc/mediatek/misc/Kconfig"
endmenu  # Peripheral

menu "Misc configs"
endmenu    # Misc

menu "Power, PMIC, Battery & Low Power related configs"
source "drivers/misc/mediatek/power/Kconfig"
endmenu  # Power

endif
```

## drivers/misc/mediatek/misc/Kconfig
```kconfig
# Related additional device.

config RGBCOMBO_LED
	tristate "PWM driven RGB LED Support"
	default n
	depends on PWM
	help
	  This option enables support for pwm driven RGB LEDs
```

## drivers/misc/mediatek/xo/Kconfig
```kconfig
config MTK_XO
	bool "MediaTek Crystal Oscillator"
	default n
	help
	  Say Y here if your SoC chip is MT8167 or MT8516
	  If unsure, say N.

config MTK_XO_NVRAM_RETRY
	bool "MediaTek XO Offset Load Retry"
	depends on MTK_XO
	default n
	help
	  Say Y here if your system using NVRAM for store XO offset data
	  If unsure, say N.
```

## drivers/misc/micom-msg/Kconfig
```kconfig
#
# Micom Interfaces for CEC/Normal Buffer data.
#
config MSG_WT61P807
	tristate "Micom interface for Normal Buffer data"
	default n
	depends on MFD_SDP_MICOM
	help
	  This driver provides the interface to transmit the Normal Buffer data for sending messages to Micom.
```

## drivers/mmc/Kconfig
```kconfig
#
# MMC subsystem configuration
#

menuconfig MMC
	tristate "MMC/SD/SDIO card support"
	depends on HAS_IOMEM
	help
	  This selects MultiMediaCard, Secure Digital and Secure
	  Digital I/O support.

	  If you want MMC/SD/SDIO support, you should say Y here and
	  also to your specific host controller driver.

if MMC

config MMC_DEBUG
	bool "MMC debugging"
	depends on MMC != n
	help
	  This is an option for use by developers; most people should
	  say N here.  This enables MMC core and driver debugging.


config HW_DECOMPRESSOR
	bool "Platform has hardware decompressor"
	#depends on (ARCH_NVT_V7 || ARCH_SDP) (selected by chip vendor)

config HW_DECOMP_BLK_MMC_SUBSYSTEM
	bool "HW decompression from the MMC layer"
	depends on HW_DECOMPRESSOR
    help
        This option enables hardware decompression from MMC layer.
        Fs layer should be aware of this special call and should
        use it properly.

config MMC_PROTECT_GPT_AREA_FROM_WRITING
	bool "Protect GPT Area"
	depends on MMC
	default n
	help
	  This option protects GPT area from writing.


source "drivers/mmc/core/Kconfig"

source "drivers/mmc/card/Kconfig"

source "drivers/mmc/host/Kconfig"

endif # MMC
```

## drivers/mstar/Kconfig
```kconfig
# drivers/MStar/Kconfig

menu "MStar Platform Configuration"

#===================================================
# MStar Chip Selection
#===================================================
choice
	prompt "MStar Chip Selection"
	default None

config MSTAR_NONE
	bool "None"


config MSTAR_PreX14
        bool "X14"
	select ARCH_SPARSEMEM_ENABLE
	select COMMON_CLKDEV
        select PLAT_MSTAR
        help
          This enables support for the ARM Ltd Versatile Express boards.

config MSTAR_X14
        bool "X14"
		select ARCH_SPARSEMEM_ENABLE
    	select COMMON_CLKDEV
	 	select PLAT_MSTAR
	  	help
	      This enables support for the ARM Ltd Versatile Express boards.

endchoice

#===================================================
# MStar Chip (auto-select)
# 0: None
#===================================================
config MSTAR_CHIP_TYPE
	int
	default 0

#===================================================
# MStar Chip Name (auto-select)
#===================================================
config MSTAR_CHIP_NAME
	string
	default "x14" if MSTAR_PreX14 || MSTAR_X14
	default "error"

#===================================================
# USB MIU1 PATCH
#===================================================
config MS_USB_MIU1_PATCH
    bool
    default n

#===================================================
# USB PATCH
#===================================================
config MSTAR_COOCAA_AUTH
    bool "Link with COOCAA Authorization"
    default n

if !MSTAR_NONE
#==========================================
# Remove this latter - cc.chen
#==========================================
source "drivers/mstar/Kconfig-Board"
source "drivers/mstar/Kconfig-MMap"

#===================================================
# MStar Device Drivers
#===================================================
comment "MStar Device Drivers"
#source "drivers/mstar/g3d/Kconfig"
#source "drivers/mstar/iomap/Kconfig"
#source "drivers/mstar/msystem/Kconfig"
#source "drivers/mstar/mpool/Kconfig"
#source "drivers/mstar/ramdisk/Kconfig"
#source "drivers/mstar/gpio/Kconfig"
#source "drivers/mstar/iic/Kconfig"
#source "drivers/mstar/emac/Kconfig"
source "drivers/mstar/usb/Kconfig"
#source "drivers/mstar/system/Kconfig"
#source "drivers/mstar/ir/Kconfig"
#source "drivers/mstar/nand/Kconfig"
#source "drivers/mstar/flash/Kconfig"
#source "drivers/mstar/mbx/Kconfig"
#source "drivers/mstar/fusion/Kconfig"
#source "drivers/mstar/firmware/Kconfig"
#source "drivers/mstar/onenand/Kconfig"
#source "drivers/mstar/gflip/Kconfig"
#source "drivers/mstar/rfid/Kconfig"
#source "drivers/mstar/vid_pre_alloc_mem/Kconfig"
#source "drivers/mstar/msglog/Kconfig"
#source "drivers/mstar/tsp/Kconfig"
#source "drivers/mstar/shire/Kconfig"
#source "drivers/mstar/sc/Kconfig"
#source "drivers/mstar/mpif/Kconfig"
#source "drivers/mstar/alsa_audio_driver/Kconfig"
#source "drivers/mstar/uarttp/Kconfig"
endif

endmenu
```

## drivers/mtd/spi-nor/Kconfig
```kconfig
menuconfig MTD_SPI_NOR
	tristate "SPI-NOR device support"
	depends on MTD
	help
	  This is the framework for the SPI NOR which can be used by the SPI
	  device drivers and the SPI-NOR device driver.

if MTD_SPI_NOR

config MTD_SPI_NOR_USE_4K_SECTORS
	bool "Use small 4096 B erase sectors"
	default y
	help
	  Many flash memories support erasing small (4096 B) sectors. Depending
	  on the usage this feature may provide performance gain in comparison
	  to erasing whole blocks (32/64 KiB).
	  Changing a small part of the flash's contents is usually faster with
	  small sectors. On the other hand erasing should be faster when using
	  64 KiB block instead of 16 × 4 KiB sectors.

	  Please note that some tools/drivers/filesystems may not work with
	  4096 B erase size (e.g. UBIFS requires 15 KiB as a minimum).

config SPI_FSL_QUADSPI
	tristate "Freescale Quad SPI controller"
	depends on ARCH_MXC
	help
	  This enables support for the Quad SPI controller in master mode.
	  We only connect the NOR to this controller now.

config SDP_MICOM_MEMIF
	tristate "SDP Micom MEMIF driver(access micom serial flash)"
	depends on ARCH_SDP1601 && SDP_MICOM_CONTROLLER
	default y
	help
	  This enables support for accessing micom serial flash by MEMIF.

config SDP_MICOM_MEMIF_USE_COSTOM_ERASE
	bool "Use custom erase logic"
	depends on SDP_MICOM_MEMIF
	default y

config SDP_MICOM_MEMIF_DISABLE_MTD_NODE
	bool "Disable making MTD Device node"
	depends on SDP_MICOM_MEMIF
	default y

endif # MTD_SPI_NOR
```

## drivers/net/ethernet/nvt_fasteth_mac/Kconfig
```kconfig
#
# NVT FASTETH MAC network device configuration
#

config NVT_FASTETH_MAC
	tristate "Novatek Fast Ethernet Mac support"
	help
	  Support for Novatek Mac and Internal phy.
	  This is the network dependent layer
	  to handle network related functionality.
	  To compile this driver as a module, choose M here.

config NVT_FASTETH_MAC_NAPI
	bool "Novatek Fast Ethernet NAPI Support"
	depends on NVT_FASTETH_MAC
	help
	  Support the NAPI function.
	  New API (also referred to as NAPI) is an interface
	  to use interrupt mitigation techniques
	  for networking devices in the driver.

choice
	prompt "Ethernet Phy Type"
	depends on NVT_FASTETH_MAC
	default NVT_INTERNAL_PHY

config NVT_MICREL_PHY_SUPPORT
	bool "Micrel Ethernet Phy Support"
	help
	  Micrel Ethernet Phy Support
	  If use Micrel Ethernet Phy,
	  please select this.
	  It is rarely used in NVT.

config NVT_RTL_PHY_SUPPORT
	bool "Realtek Ethernet Phy Support"
	help
	  Realtek Ethernet Phy Support
	  If use Realtek Ethernet Phy,
	  please select this.
	  It is rarely used in NVT now.

config NVT_ICPLUS_PHY_SUPPORT
	bool "IC Plus Ethernet Phy Support"
	help
	  IC Plus Ethernet Phy Support.
	  If use IC Plus Ethernet Phy,
	  please select this.
	  It is rarely used in NVT.

config NVT_INTERNAL_PHY
	bool "Novatek Ethernet Phy Support"
	help
	  Novatek Ethernet Phy Support.
	  If use Novatek Ethernet Phy,
	  please select this.
	  It is most used in NVT.
endchoice

choice
	prompt "Novatek Ethernet PHY Type"
	depends on NVT_FASTETH_MAC && NVT_INTERNAL_PHY
	default NVT_PHY_NVT72673 if ARCH_NVT72673
	default NVT_PHY_NVT72172
	help
	  This value can be used to select the type of Novatek
	  Ethernet PHY

config NVT_PHY_NVT72673
	bool "NVT72673"
	help
	  The Novatek Ethernet NVT72673 PHY

config NVT_PHY_NVT72172
	bool "NVT72172"
	help
	  The Novatek Ethernet NVT72172 PHY
endchoice
```

## drivers/net/ethernet/sdp/Kconfig
```kconfig
#
# Samsung DTV Platform device configuration
#

config SDP_MAC
        depends on ARCH_SDP
        tristate "SDP Ethernet MAC Driver"
		default y
        select MII
        select PHYLIB

config SDP_MAC_DEBUG
		depends on SDP_MAC
		bool "Print Debug Msg for SDP MAC"

if SDP_MAC

# Use Normal Descriptor
config SDP_MAC_NORMAL_DESC
		default n
		bool	"MAC Use Normal Descriptor"

choice
        prompt "How to set MAC Address?"
        default MAC_SET_RAMDOM

config MAC_SET_BY_USER
        depends on SDP_MAC
        bool    "MAC set mac address by user"

config MAC_SET_RANDOM
        depends on SDP_MAC
        bool    "Generate software assigned random ethernet addr"
endchoice


if MAC_SET_BY_USER

config MAC_FRONT_4BYTE
        depends on MAC_SET_BY_USER
        hex     "MAC Mac address front 4 byte"
        default 0xFFFFFFFF

config MAC_END_2BYTE
        depends on MAC_SET_BY_USER
        hex     "MAC Mac address end 2 byte"
        default 0xFFFF
endif # MAC_SET_BY_USER

endif # SDP_MAC
```

## drivers/nvmem/Kconfig
```kconfig
menuconfig NVMEM
	bool "NVMEM Support"
	help
	  Support for NVMEM(Non Volatile Memory) devices like EEPROM, EFUSES...

	  This framework is designed to provide a generic interface to NVMEM
	  from both the Linux Kernel and the userspace.

	  This driver can also be built as a module. If so, the module
	  will be called nvmem_core.

	  If unsure, say no.

if NVMEM

config MTK_EFUSE
	tristate "Mediatek SoCs EFUSE support"
	depends on ARCH_MEDIATEK || COMPILE_TEST
	depends on HAS_IOMEM
	help
	  This is a driver to access hardware related data like sensor
	  calibration, HDMI impedance etc.

	  This driver can also be built as a module. If so, the module
	  will be called efuse-mtk.

endif
```

## drivers/samsung/Kconfig
```kconfig
menu "Samsung drivers"

source drivers/samsung/background_recompress/Kconfig

source drivers/samsung/smart_deadlock/Kconfig

source drivers/samsung/bptime/Kconfig

endmenu
```

## drivers/samsung/background_recompress/Kconfig
```kconfig
menu "Background ReCompress Support"

config BACKGROUND_RECOMPRESS
	bool "Background Re-Comporess Framwork"
	depends on ZRAM && CRYPTO_ZSTD
	default n
	help
	This frame-work is for re-compressing page with higher level in zstd to
	save memory.
	This feature is for only Tizen system.


config BACKGROUND_RECOMPRESS_LEVEL
	int "Background Re-compress compressing level"
	depends on BACKGROUND_RECOMPRESS
	default 19 if CRYPTO_ZSTD
	default 1
	help
	This is compress level of selected algorithm.

config BACKGROUND_RECOMPRESS_MIN_SIZE
	int "Background Re-Comporess min threshold size value. If size is less than min, skip recompress"
	depends on BACKGROUND_RECOMPRESS
	default 100
	help
	If compressed size is bigger than threshold, trying recompress.

config BACKGROUND_RECOMPRESS_MAX_SIZE
	int "Background Re-Comporess max threshold size value. If size is bigger than max, skip recompress"
	depends on BACKGROUND_RECOMPRESS
	default 4095
	help
	If compressed size is less than threshold, trying recompress.

config BACKGROUND_RECOMPRESS_CPU_THRESHOLD
	int "Background Re-Comporess cpu threshold value which is regarded as idle state"
	depends on BACKGROUND_RECOMPRESS
	default 50
	help
	If cpu usage is smaller than threshold, trying recompress.

config BACKGROUND_RECOMPRESS_SCAN_COUNT
	int "Background Re-Comporess scan count at once in idle state"
	depends on BACKGROUND_RECOMPRESS
	default 128 
	help
	Scan count of trying recompress in idle state.

config BACKGROUND_RECOMPRESS_INTERVAL
	int "Background Re-Comporess interval value. Try to recompress after interval from saved time"
	depends on BACKGROUND_RECOMPRESS
	default 10
	help
	Min interval to try reompress.

config BACKGROUND_RECOMPRESS_PROFILE_MODE
	bool "Background Re-Comporess Profile Mode"
	default n
	depends on BACKGROUND_RECOMPRESS
	depends on KDEBUGD || !CONFIG_OOM_PANIC
	help
	This option will enable profiling in background_re-compress framework. Now /proc/meminfo will show recompress
	memeory status.

endmenu
```
